		PROCESSOR 16F876A
		#INCLUDE <P16F876A.INC>
		
; 변수 선언
		VARIABLE	W_TEMP		=	20H
		VARIABLE	STATUS_TEMP	=	21H
		VARIABLE	INT_CNT		=	22H
		VARIABLE	D_10SEC		=	23H
		VARIABLE	D_1SEC		=	24H
		VARIABLE	DISP_CNT	=	25H
		VARIABLE	COM_A		=	26H
		VARIABLE	COM_B		=	27H
		VARIABLE	D_10MIN		=	28H
		VARIABLE	D_1MIN		=	29H
		VARIABLE	DBUF1		=	30H
		VARIABLE	DBUF2		=	31H
		
; MAIN PROGRAM

	ORG		00H
	GOTO	START_UP
	ORG		04H
	
; ISR 시작 번지
	MOVWF	W_TEMP ; 현재 사용되고 있는 W REG를 저장
	SWAPF	STATUS,W
	MOVWF	STATUS_TEMP
	CALL  	DISP ; DISPLAY 부 프로그램
	SWAPF 	STATUS_TEMP,W ; 저장된 내용으로 복원
	MOVWF 	STATUS
	SWAPF 	W_TEMP,F
	SWAPF 	W_TEMP,W
	BCF 	INTCON,2
	RETFIE
	
; DISPLAY ROUTINE
DISP
	INCF	DISP_CNT
	BTFSS	DISP_CNT, 1
	GOTO	DISPM

DISPN
	BTFSS	DISP_CNT, 0 
	GOTO	DISP3
	GOTO	DISP4


DISPM
	BTFSS	DISP_CNT, 0
	GOTO	DISP2
	GOTO	DISP1
	

; 처음 들어올 때	
DISP1
	MOVLW	B'00000000'
	MOVWF	PORTA
	MOVWF	PORTC
	
	MOVF	D_10SEC, W
	CALL	CONV2
	MOVWF	PORTA
	MOVF	D_10SEC, W
	CALL	CONV1
	MOVWF	PORTC

	
	BSF		PORTA,3
	BSF 	PORTA,2
	BCF 	PORTB,2
	BSF		PORTB,1
	

	RETURN
	
; 다음 들어올 때
DISP2
	MOVLW	B'00000000'
	MOVWF	PORTA
	MOVWF	PORTC
	
	MOVF	D_1SEC, W
	CALL	CONV2
	MOVWF	PORTA
	MOVF	D_1SEC, W
	CALL	CONV1
	MOVWF	PORTC
	
	BSF		PORTA,3
	BSF 	PORTA,2
	BSF 	PORTB,2
	BCF		PORTB,1
		
	INCF	INT_CNT
	


	RETURN	
	
DISP3
	MOVLW	B'00000000'
	MOVWF	PORTA
	MOVWF	PORTC
	
	MOVF	D_1MIN, W
	CALL	CONV2
	MOVWF	PORTA
	MOVF	D_1MIN, W
	CALL	CONV1
	MOVWF	PORTC

	
	BTFSS		INT_CNT, 7
	BSF			PORTA,0	
	
	
	BSF		PORTA,3
	BCF 	PORTA,2
	BSF 	PORTB,2
	BSF		PORTB,1	
	

	
	RETURN	
	
DISP4
	MOVLW	B'00000000'
	MOVWF	PORTA
	MOVWF	PORTC
	
	MOVF	D_10MIN, W
	CALL	CONV2
	MOVWF	PORTA
	MOVF	D_10MIN, W
	CALL	CONV1
	MOVWF	PORTC


	BCF		PORTA,3
	BSF 	PORTA,2
	BSF 	PORTB,2
	BSF		PORTB,1	
	
	INCF	INT_CNT
	


	RETURN	


	
	
		
; MAIN PROGRAM 시작
START_UP
	BSF 	STATUS,RP0 ; RAM BANK 1 선택
	MOVLW 	B'00000000' ; PORT I/O 선택
	MOVWF 	TRISA
	MOVWF	TRISC
	MOVLW	B'11111001'
	MOVWF	TRISB
	MOVLW 	B'00000111' ; PORT I/O 선택
	MOVWF	ADCON1

; INTERRUPT 시간 설정 --- 2.048msec 주기
	MOVLW 	B'00000010' ; 2.048msec
	MOVWF 	OPTION_REG
	BCF 	STATUS,RP0 ; RAM BANK 0 선택
	BSF 	INTCON,5 ; TIMER INTERRUPT ENABLE
	BSF 	INTCON,7 ; GLOBAL INT. ENABLE
	GOTO 	MAIN_ST

MAIN_ST
	CLRF	INT_CNT
	CLRF	D_10SEC
	CLRF	D_1SEC
	CLRF	D_10MIN
	CLRF	D_1MIN
	
M_LOOP
; interrupt가 들어온 횟수 확인(시간계수)
	MOVLW 	.244
	SUBWF 	INT_CNT,W
	BTFSS 	STATUS, Z
	GOTO 	XLOOP
; 1sec 마다 들어오는 부분
CK_LOOP
	CLRF 	INT_CNT ; 다음 1초를 기다리기 위한 초기화
	INCF 	D_1SEC ; 1초 단위 변수 증가
	MOVLW 	.10
	SUBWF 	D_1SEC,W
	BTFSS 	STATUS, Z
	GOTO 	XLOOP
; 10초마다 들어오는 부분
	CLRF 	D_1SEC ; 다음 10초를 기다리기 위한 초기화
	INCF 	D_10SEC ; 10초 단위 변수 증가
	MOVLW 	.6
	SUBWF 	D_10SEC,W
	BTFSS 	STATUS, Z
;	CLRF 	D_10SEC ; 10초 단위를 초기화
	GOTO 	XLOOP
; 1분마다 들어오는 부분
	CLRF	D_10SEC
	INCF 	D_1MIN ; 10초 단위 변수 증가
	MOVLW 	.10
	SUBWF 	D_1MIN,W
	BTFSS 	STATUS, Z
;	CLRF 	D_1MIN ; 10초 단위를 초기화
	GOTO 	XLOOP
; 10분마다 들어오는 부분
	CLRF	D_1MIN
	INCF 	D_10MIN ; 10초 단위 변수 증가
	MOVLW 	.6
	SUBWF 	D_10MIN,W
	BTFSC 	STATUS, Z
	CLRF 	D_10MIN ; 10초 단위를 초기화
	GOTO 	XLOOP

; 나머지 시간 동안 사용자 기능을 수행하기 위한 프로그램 영역


XLOOP
; KEY 확인하여 KEY에 따른 기능 수행
; 기능에 따른 부저 울리기 등
	BTFSC	PORTB, 5
	;GOTO	M_LOOP
	GOTO SWTEST1
	GOTO 	SW3_RESET
	
SWTEST1
 	BTFSC PORTB, 3
 	GOTO M_LOOP
 	GOTO SW1_STOP
	
	
SW3_RESET

		BCF	PORTA, 4 ; BUZZER ON
		GOTO	MAIN_ST

SW1_STOP
 		;CALL	LED

 		BCF	PORTB, 7
 		MOVLW	7FH
		MOVWF	PORTC
 		
 		
 		BTFSC	PORTB, 4
 		GOTO SW1_STOP
 		GOTO	XLOOP
 	
LED
		MOVLW	B'00000000'
		MOVWF	PORTC
		BCF		PORTB, 7
		MOVLW	80H
		MOVWF	PORTC
	;	CALL		DELAY
	;	MOVLW	0BFH
	;	MOVWF	PORTC
	;	CALL		DELAY
	;	MOVLW	0DFH
	;	MOVWF	PORTC
	;	CALL		DELAY
		
		

	
CONV1;;PORTC 
	ANDLW 	0FH ; W의 low nibble 값을 변환하자.
	ADDWF 	PCL,F ; PCL+변환 숫자값 --> PCL
; PC가 변경되므로 이 명령어 다음 수행 위
; 치가 변경되지요.
	RETLW 	B'11100111' ;'0'하는 값이 W로 들어옴
	RETLW 	B'01100000' ; '1'를 표시 하는 값
	RETLW 	B'11000011' ; '2'를 표시 하는 값
	RETLW 	B'11100010' ; '3'를 표시 하는 값
	RETLW 	B'01100100' ; '4'를 표시 하는 값
	RETLW 	B'10100110' ; '5'를 표시 하는 값
	RETLW 	B'00100111' ; '6'를 표시 하는 값
	RETLW 	B'11100100' ;7'를 표시 하는 값
	RETLW 	B'11100111' ; '8'를 표시 하는 값
	RETLW 	B'11100100' ; '9'를 표시 하는 값
	RETLW 	B'00000010' ; '-'를 표시 하는 값
	RETLW 	B'00000000' ; ' '를 표시 하는 값
	RETLW 	B'00011010' ; 'C'를 표시 하는 값
	RETLW 	B'00000000' ; '．'를 표시 하는 값
	RETLW 	B'10011110' ; 'E'를 표시 하는 값
	RETLW 	B'10001110' ; 'F'를 표시 하는 값
	
CONV2;;PORTA
	ANDLW 	0FH ; W의 low nibble 값을 변환하자.
	ADDWF 	PCL,F ; PCL+변환 숫자값 --> PCL
; PC가 변경되므로 이 명령어 다음 수행 위
; 치가 변경되지요.
	RETLW 	B'00010000' ;'0'를 표시 하는 값이 W로 들어옴
	RETLW 	B'00010000' ; '1'를 표시 하는 값
	RETLW 	B'00010010' ; '2'를 표시 하는 값
	RETLW 	B'00010010' ; '3'를 표시 하는 값
	RETLW 	B'00010010' ; '4'를 표시 하는 값
	RETLW 	B'00010010' ; '5'를 표시 하는 값
	RETLW 	B'00010010' ; '6'를 표시 하는 값
	RETLW 	B'00010000' ; '7'를 표시 하는 값
	RETLW 	B'00010010' ; '8'를 표시 하는 값
	RETLW 	B'00010010' ; '9'를 표시 하는 값
	RETLW 	B'00010010' ; '-'를 표시 하는 값
	RETLW 	B'00010000' ; ' '를 표시 하는 값
	RETLW 	B'00011010' ; 'C'를 표시 하는 값
	RETLW 	B'00010001' ; '．'를 표시 하는 값
	RETLW 	B'10011110' ; 'E'를 표시 하는 값
	RETLW 	B'10011110' ; 'F'를 표시 하는 값



DELAY	; DELAY 서브루틴						
		MOVLW	.125
		MOVWF	DBUF1
LP1		MOVLW	.200
		MOVWF	DBUF2
LP2		NOP
		DECFSZ	 DBUF2,F
		GOTO	LP2
		DECFSZ	 DBUF1,F
		GOTO	LP1
		RETURN		
	

END