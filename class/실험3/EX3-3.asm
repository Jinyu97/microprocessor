	PROCESSOR 16F876A

	#INCLUDE <P16F876A.INC>

; ---변수선언---
VARIABLE	LED1	= 	20H
VARIABLE	DBUF1	=	22H
VARIABLE	DBUF2	=	23H


	ORG	0000
	BSF	STATUS, RP0
	MOVLW	B'00000001'
	MOVWF	TRISA
	MOVLW	B'00000000'
	MOVWF	TRISC
	MOVLW	B'00000111'
	MOVWF	ADCON1
	BCF	STATUS, RP0

;MAIN PROGRAM

	MOVLW	01H
	ADDLW	00H
	MOVWF	LED1

CC;

	BTFSS	PORTA, 0
	GOTO 	RIGHT
	GOTO 	LEFT

RIGHT;

	MOVF	LED1, W
	MOVWF	PORTC
	CALL	DELAY
	RRF	LED1
	GOTO	CC

LEFT;

	MOVF	LED1, W
	MOVWF	PORTC
	CALL	DELAY
	RLF	LED1
	GOTO	CC

; SUBROUTINE

DELAY	
	MOVLW	.125		;130번을 확인하기 위한 변수
	MOVWF	DBUF1
LP1	MOVLW	.200		;200번을 확인하기 위한 변수
	MOVWF	DBUF2
LP2	NOP
	DECFSZ	DBUF2, F
	GOTO	LP2
	DECFSZ	DBUF1, F	;변수를 감소시켜 가면서 00이 되었나 확인
	GOTO	LP1		;ZERO가 아니면 여기에 들어옴
	RETURN

	END

