		PROCESSOR 16F876A

		#INCLUDE <P16F876A.INC>

; ---변수선언---

		VARIABLE	LED1	= 	20H
		VARIABLE	DBUF1	=	22H
		VARIABLE	DBUF2	=	23H



		ORG	0000
		BSF	STATUS, RP0
		CLRF	TRISA
		CLRF	TRISC
		MOVLW	B'00000111'
		MOVWF	ADCON1
		BCF	STATUS, RP0

; MAIN PROGRAM

		MOVLW	01
		ADDLW	00		;CF를 0으로 만듦
		MOVWF	LED1		;초기값 01을 넣음
		
LOOP	
		MOVF	LED1, W
		MOVWF	PORTC		;W을 PORTC에 출력
		RLF	LED1, F		;ROTATE 시킴
		CALL	DELAY
		GOTO	LOOP
		
; SUBROUTINE

DELAY	
		MOVLW	.125		;130번을 확인하기 위한 변수
		MOVWF	DBUF1
LP1		MOVLW	.200		;200번을 확인하기 위한 변수
		MOVWF	DBUF2
LP2		NOP
		DECFSZ	DBUF2, F
		GOTO	LP2
		DECFSZ	DBUF1, F	;변수를 감소시켜 가면서 00이 되었나 확인
		GOTO	LP1		;ZERO가 아니면 여기에 들어옴
		RETURN
		
		END
