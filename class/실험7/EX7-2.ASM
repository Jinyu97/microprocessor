	PROCESSOR 16F876A

	#INCLUDE <P16F876A.INC>



; ---변수 선언---

VARIABLE DBUF1 = 20H
VARIABLE DBUF2 = 21H
VARIABLE DBUF3 = 22H
VARIABLE COM_B = 23H
VARIABLE COM_C = 24H

			
	ORG	0000
	BSF	STATUS, RP0
	MOVLW	B'00000000'
	MOVWF	TRISA
	BCF	STATUS, RP0
		
; '김종화'의 코드는 '1' '00010' '11,101' '10001' + '1' '01110' '01,101' '10111' '1' '10100' '01,110' '00001'		

; MAIN

	MOVLW	0A3H		; 화면 클리어
	MOVWF	COM_B
	CALL	RS232C
	CALL	DELAY
	
	MOVLW	1
	MOVWF	COM_B
	CALL	RS232C
	CALL	DELAY

	MOVLW	0A2H
	MOVWF	COM_B
	CALL	RS232C
	CALL	DELAY

	MOVLW	B'10001011'
	MOVWF	COM_B
	CALL	RS232C
	CALL	DELAY		; 안정된 동작을 위하여
	MOVLW	B'10110001'
	MOVWF	COM_B
	CALL	RS232C
	CALL	DELAY		; 안정된 동작을 위하여
	MOVLW	B'10111001'
	MOVWF	COM_B
	CALL	RS232C
	CALL	DELAY		; 안정된 동작을 위하여
	MOVLW	B'10110111'
	MOVWF	COM_B
	CALL	RS232C
	CALL	DELAY		; 안정된 동작을 위하여
	MOVLW	B'11010001'
	MOVWF	COM_B
	CALL	RS232C
	CALL	DELAY		; 안정된 동작을 위하여
	MOVLW	B'11000001'
	MOVWF	COM_B
	CALL	RS232C
	CALL	DELAY		; 안정된 동작을 위하여

	MOVLW	00H
	MOVWF	COM_B
	CALL	RS232C
	CALL	DELAY		; 안정된 동작을 위하여
BBLP	
	GOTO	BBLP

;-----------------------------------------------------------

RS232C	MOVLW	8
	MOVWF	COM_C
	BCF	PORTA, 0	; start bit=0
	CALL	DELAYB
; 데이터 출력 LOOP
R_LP	BTFSS	COM_B, 0
	GOTO	BITX
	; 0 bit =1
	BSF	PORTA, 0
	GOTO	NEXT1
BITX	BCF	PORTA, 0
NEXT1	CALL	DELAYB
; 다음 데이터 만들기 및 마지막 확인
	RRF	COM_B, F
	DECFSZ	COM_C
	GOTO	R_LP
; stop bit 출력
	BSF	PORTA, 0
	CALL	DELAYB
	RETURN

;-----------------------------------------------------------

;--- BAUD-RATE DELAY ---
;--- 208USEC DELAY   ---

DELAYB
	MOVLW		.51
	MOVWF		DBUF1
LP1
	NOP
	DECFSZ		DBUF1, F
	GOTO		LP1
	
	RETURN



;--- LONG DELAY FOR LCD COMMAND   ---
		
DELAY
	MOVLW		0FFH
	MOVWF		DBUF2
LP2
	MOVLW		05H
	MOVWF		DBUF3
LP3
	NOP
	DECFSZ		DBUF3, F
	GOTO		LP3
	DECFSZ		DBUF2, F
	GOTO		LP2
	
	RETURN
	
	END
