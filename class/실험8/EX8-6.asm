	PROCESSOR 16F876A

	#INCLUDE <P16F876A.INC>


; ---변수 선언---
	VARIABLE	W_TEMP		= 20H
	VARIABLE	STATUS_TEMP = 21H
	VARIABLE	EXINT_CNT	= 22H
	VARIABLE	DBUF1		= 23H
	VARIABLE	DBUF2		= 24H

; MAIN PROGRAM
	ORG		00H
	GOTO		START_UP

	ORG		04H		; ISR 시작 번지

	MOVWF		W_TEMP		; 현재 사용되고 있는 W REG를 저장
	SWAPF		STATUS, W
	MOVWF		STATUS_TEMP
	INCF		EXINT_CNT	
	SWAPF		STATUS_TEMP, W	; 저장된 내용으로 복원
	MOVWF		STATUS
	SWAPF		W_TEMP, F
	SWAPF		W_TEMP, W
	BCF		INTCON, INTF
	RETFIE

; main program 시작
START_UP	
	BSF		STATUS, RP0	; RAM BANK 1 선택
	CLRF		TRISC
	BSF		TRISB, 0

;	BSF		OPTION_REG, INTEDG
	BCF		STATUS, RP0	; RAM BANK 0 선택

	BSF		INTCON, INTE	; EXTERNAL INTERRUPT ENABLE
	BSF		INTCON, GIE	; GLOBAL INT. ENABLE

	CLRF		EXINT_CNT
	MOVLW		B'00000001'
	MOVWF		PORTC
	BCF		STATUS, C	; C값 0으로 초기화
	
M_LOOP
	BTFSS		EXINT_CNT, 0
	GOTO		M_LOOP
	RLF			PORTC
	CALL		DELAY
	GOTO		M_LOOP
	

DELAY	
	MOVLW		.125
	MOVWF		DBUF1
LP1	MOVLW		.200
	MOVWF		DBUF2
LP2	NOP
	DECFSZ		DBUF2, F
	GOTO		LP2
	DECFSZ		DBUF1, F
	GOTO		LP1	
	RETURN
		
	END